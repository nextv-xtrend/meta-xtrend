## conf/machine/et10000.conf
```bitbake
#@TYPE: Machine
#@NAME: Xtrend et10000
#@DESCRIPTION: Machine configuration for the Xtrend et10000

MACHINE_FEATURES += "dvb-c blindscan-dvbc transcoding"

CHIPSET = "bcm7425"

require conf/machine/include/etxx00-2g.inc

#EXTRA_IMAGEDEPENDS += " \
#	${@bb.utils.contains("DISTRO_VERSION", "4", "", "enigma2-plugin-extensions-kodi", d)} \
#"

PREFERRED_PROVIDER_virtual/egl = "xtrend-v3ddriver-${MACHINE}"
PREFERRED_PROVIDER_virtual/libgles2 = "xtrend-v3ddriver-${MACHINE}"
```

## conf/machine/et4x00.conf
```bitbake
#@TYPE: Machine
#@NAME: Xtrend et4x00
#@DESCRIPTION: Machine configuration for the Xtrend et4x00

MACHINE_FEATURES += "videoenhancement"

CHIPSET = "bcm7358"
DEFAULTTUNE = "mips32el-nf"

require conf/machine/include/etxx00-2g.inc
```

## conf/machine/et7x00.conf
```bitbake
#@TYPE: Machine
#@NAME: Xtrend et7x00
#@DESCRIPTION: Machine configuration for the Xtrend et7x00

CHIPSET = "bcm7362"

MACHINE_FEATURES += "textlcd dvb-c blindscan-dvbc videoenhancement"
MACHINE_KERNEL_PR = "r0"

require conf/machine/include/et7k.inc
```

## conf/machine/et8000.conf
```bitbake
#@TYPE: Machine
#@NAME: Xtrend et8000
#@DESCRIPTION: Machine configuration for the Xtrend et8000

MACHINE_FEATURES += "textlcd dvb-c blindscan-dvbc videoenhancement"

CHIPSET = "bcm7241"

require conf/machine/include/etxx00-2g.inc
```

## conf/machine/et8500.conf
```bitbake
#@TYPE: Machine
#@NAME: Xtrend et8500
#@DESCRIPTION: Machine configuration for the Xtrend et8500

CHIPSET = "bcm7241"

MACHINE_FEATURES += "dvb-c blindscan-dvbc videoenhancement"
MACHINE_KERNEL_PR = "r0"

require conf/machine/include/et8k.inc
```

## conf/machine/include/etxx00-2g.inc
```bitbake
require conf/machine/include/et.inc

PREFERRED_PROVIDER_virtual/kernel = "linux-etxx00"
PREFERRED_VERSION_linux-etxx00 = "4.10.6"

PREFERRED_PROVIDER_virtual/blindscan-dvbc = "et-blindscan-dvbc-utils-${MACHINE}"

MKUBIFS_ARGS = "-m 2048 -e 126976 -c 8192"
UBINIZE_ARGS = "-m 2048 -p 128KiB"

IMAGE_CMD_ubi_prepend = " \
	rm -Rf ${IMAGE_ROOTFS}/tmp/*; \
	"

MACHINE_FEATURES += "extrakernelwifi"

MACHINE_KERNEL_PR = "r0"
```
